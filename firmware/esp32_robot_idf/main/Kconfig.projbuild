## firmware/esp32_robot_idf/main/Kconfig.projbuild
```kconfig
menu "Better Robotics"

choice BR_BOARD
    prompt "Target board"
    default BR_BOARD_AITHINKER_CAM if IDF_TARGET_ESP32
    default BR_BOARD_C3_SUPERMINI  if IDF_TARGET_ESP32C3
    help
        Selects board-specific defaults: camera/PSRAM presence, pin map
        defaults, and the forbidden-pin set used by pin_config.c's
        validator. Choices are filtered to the active IDF target.

config BR_BOARD_AITHINKER_CAM
    bool "AI-Thinker ESP32-CAM (camera + PSRAM)"
    depends on IDF_TARGET_ESP32
    select BR_HAS_CAMERA
    select BR_HAS_PSRAM

config BR_BOARD_DEVKIT
    bool "ESP32 DevKitV1 / WROOM-32 (no camera, no PSRAM)"
    depends on IDF_TARGET_ESP32

config BR_BOARD_C3_SUPERMINI
    bool "ESP32-C3 SuperMini (RISC-V, no camera, no PSRAM)"
    depends on IDF_TARGET_ESP32C3

endchoice

# Hidden caps — driven by the board choice. Source files and build deps
# gate on these, so the camera path can be dropped on no-camera boards
# without scattering CONFIG_BR_BOARD_* across every #ifdef.
config BR_HAS_CAMERA
    bool

config BR_HAS_PSRAM
    bool

endmenu
```

## firmware/esp32_robot_idf/sdkconfig.defaults
```kconfig
# Defaults applied on first build to every board. Board-specific overrides
# live in sdkconfig.defaults.board.<name>, layered on top via build.sh:
#   SDKCONFIG_DEFAULTS="sdkconfig.defaults;sdkconfig.defaults.board.<name>"
# Not named sdkconfig.defaults.<target> because two boards share IDF_TARGET
# esp32 (AI-Thinker CAM, DevKitV1) — auto-target-overlay would apply the
# wrong file to one of them.

CONFIG_ESPTOOLPY_FLASHSIZE_4MB=y

# CPU clock is set per-board: classic ESP32 can run 240, C3 maxes at 160.

# Logging — IDF v5.5 disabled colors by default; restore them so the
# recovery console renders I/W/E lines green/yellow/red.
CONFIG_LOG_DEFAULT_LEVEL_INFO=y
CONFIG_LOG_COLORS=y
CONFIG_BOOTLOADER_LOG_COLORS=y

# Bluetooth (NimBLE — matches Arduino stack)
CONFIG_BT_ENABLED=y
CONFIG_BT_NIMBLE_ENABLED=y
CONFIG_BT_CONTROLLER_ONLY=n
CONFIG_BT_BLUEDROID_ENABLED=n
# Single dashboard at a time. Pair-mailbox (Phase 2.F.2 BLE-relay) was
# why this was 4 and CCCDs were 32; with that gone, 2 connections is
# enough headroom for "operator's dashboard + a brief overlap during
# refresh". CCCDs = 2 conns × ~10 notify-capable chars, with margin.
CONFIG_BT_NIMBLE_MAX_CONNECTIONS=2
CONFIG_BT_NIMBLE_MAX_CCCDS=24

# Networking — buffer sizes tuned during the (since-removed) WebRTC/libpeer
# era for SCTP + video-frame UDP bursts. Left in place: they haven't caused
# problems for HTTP MJPEG or BLE OTA, and re-tuning without a WebRTC-shaped
# workload to validate against would be guessing. Revisit if flash/heap
# budget pressure calls for reclaiming this headroom.
CONFIG_LWIP_TCP_SND_BUF_DEFAULT=16384
CONFIG_LWIP_TCP_WND_DEFAULT=16384
CONFIG_ESP_WIFI_DYNAMIC_TX_BUFFER_NUM=32
CONFIG_LWIP_UDP_RECVMBOX_SIZE=8
CONFIG_LWIP_PBUF_POOL_SIZE=16

# IPv6. On apartment-WiFi-as-a-service the IPv4 path goes through a
# centralized gateway that adds 100-300 ms to lateral traffic between
# residents — but the ISP delegates each device a global IPv6 address,
# and IPv6 packets between devices on the same /64 route directly via
# neighbor discovery. Enabling v6 lets any peer-to-peer LAN traffic pair
# host-v6↔host-v6, bypassing the slow v4 NAT entirely.
CONFIG_LWIP_IPV6=y
CONFIG_LWIP_IPV6_AUTOCONFIG=y
# DHCPv6 stateless. WhiteSky-Beckon (and likely other apt-WiFi) doesn't
# auto-send RAs to non-Apple clients via SLAAC, but does run a DHCPv6
# server. Phones get global v6 because Apple stacks do DHCPv6 by default.
CONFIG_LWIP_IPV6_DHCP6=y

# mbedTLS — hardware AES/SHA always on (free on this chip, used by both
# WiFi WPA and any future TLS).
CONFIG_MBEDTLS_HARDWARE_AES=y
CONFIG_MBEDTLS_HARDWARE_SHA=y

# Trim mbedTLS record buffers from the 16 KiB default to save internal
# heap that feeds the camera DMA's 32 KiB contiguous request.
CONFIG_MBEDTLS_ASYMMETRIC_CONTENT_LEN=y
CONFIG_MBEDTLS_SSL_IN_CONTENT_LEN=2048
CONFIG_MBEDTLS_SSL_OUT_CONTENT_LEN=1500

# Partition table — OTA needs two app slots + factory.
CONFIG_PARTITION_TABLE_CUSTOM=y
CONFIG_PARTITION_TABLE_CUSTOM_FILENAME="partitions.csv"
```

## firmware/esp32_robot_idf/sdkconfig.defaults.board.aithinker_cam
```kconfig
# AI-Thinker ESP32-CAM — classic ESP32 with OV2640/OV3660 camera, 4 MB
# SPI PSRAM, camera streams over HTTP MJPEG. The "headline" board.
CONFIG_BR_BOARD_AITHINKER_CAM=y

# Classic ESP32 max — 240 MHz is a free linear speedup over the IDF
# 160 MHz default; camera JPEG encode + WiFi/BLE coex both benefit.
CONFIG_ESP_DEFAULT_CPU_FREQ_MHZ_240=y

CONFIG_ESP32_SPIRAM_SUPPORT=y
CONFIG_SPIRAM_USE_MALLOC=y
CONFIG_SPIRAM_TRY_ALLOCATE_WIFI_LWIP=y

# Push allocations to PSRAM by default. mbedTLS contexts (HTTPS OTA),
# NimBLE non-critical state — none of these need internal-only RAM.
# Default threshold (16 KB) keeps everything <16 KB internal, which fragments
# the heap and starves the camera DMA's 32 KB contiguous request.
# - ALWAYSINTERNAL=256 — only allocations <256 B forced internal (small,
#   high-frequency stuff like task control blocks).
# - RESERVE_INTERNAL=32768 — keep 32 KB internal headroom unused by PSRAM-
#   capable callers, so the camera's MALLOC_CAP_INTERNAL+CAP_DMA call
#   always finds its block.
CONFIG_SPIRAM_MALLOC_ALWAYSINTERNAL=256
CONFIG_SPIRAM_MALLOC_RESERVE_INTERNAL=32768

# esp32-camera component knobs — present here so non-camera boards (which
# don't include esp32-camera in PRIV_REQUIRES) don't trip "unknown CONFIG"
# warnings on Kconfig load.
CONFIG_CAMERA_TASK_STACK_SIZE=4096

# AI-Thinker boards often ship with Boya flash chips; generic driver works
# but the Boya-specific one has tuned read/write timings.
CONFIG_SPI_FLASH_SUPPORT_BOYA_CHIP=y
```

## firmware/esp32_robot_idf/sdkconfig.defaults.board.aithinker_cam_webrtc
```kconfig
# AI-Thinker ESP32-CAM + WebRTC video. Delta from board.aithinker_cam —
# build.sh composes both overlays:
#   SDKCONFIG_DEFAULTS="sdkconfig.defaults
#                       ;sdkconfig.defaults.board.aithinker_cam
#                       ;sdkconfig.defaults.board.aithinker_cam_webrtc"
# ~215 KB heavier image than the MJPEG-only sibling.
CONFIG_BR_WEBRTC_ESP_PEER=y

# mbedTLS bits libpeer's DTLS-SRTP handshake needs. Set explicitly here
# rather than via Kconfig `select` chain on BR_WEBRTC_ESP_PEER — the chain
# wasn't reliably propagating in the multi-overlay setup (root cause
# unclear; the same select chain works in single-defaults setups).
# MBEDTLS_X509_CREATE_C and MBEDTLS_CIPHER_MODE_CTR are defined
# unconditionally by esp-idf's mbedtls/port config — nothing to set.
CONFIG_MBEDTLS_SSL_PROTO_DTLS=y
CONFIG_MBEDTLS_SSL_DTLS_SRTP=y
CONFIG_MBEDTLS_KEY_EXCHANGE_ECDHE_ECDSA=y
CONFIG_MBEDTLS_ECDH_C=y
CONFIG_MBEDTLS_ECDSA_C=y
CONFIG_MBEDTLS_ECP_DP_SECP256R1_ENABLED=y
CONFIG_MBEDTLS_GCM_C=y
CONFIG_MBEDTLS_SHA1_C=y
CONFIG_MBEDTLS_HKDF_C=y
```

## firmware/esp32_robot_idf/sdkconfig.defaults.board.c3_supermini
```kconfig
# ESP32-C3 SuperMini — RISC-V single core, BLE 5.0 only (no BT Classic),
# no camera peripheral (no DVP parallel interface), no PSRAM. Native USB
# CDC-JTAG on GPIO 18/19; no external USB-UART bridge.
CONFIG_BR_BOARD_C3_SUPERMINI=y

# C3 maxes at 160 MHz — the base file's 240 MHz default isn't valid here.
CONFIG_ESP_DEFAULT_CPU_FREQ_MHZ_160=y

# Console over native USB-CDC instead of UART0. Lets the user wire motors
# / encoders to GPIO 20-21 (the UART0 pins) without losing log output.
CONFIG_ESP_CONSOLE_USB_SERIAL_JTAG=y
```

## firmware/esp32_robot_idf/sdkconfig.defaults.board.devkit
```kconfig
# ESP32 DevKitV1 / WROOM-32 — classic ESP32, no camera, no PSRAM. About
# 25 usable GPIOs vs. the AI-Thinker's ~8, so motor + encoder layouts have
# room to spread out without colliding with camera-reserved pins.
CONFIG_BR_BOARD_DEVKIT=y

# Classic ESP32 max. No camera DMA pressure on this board, so the CPU
# can sit at full clock without contending with peripheral bandwidth.
CONFIG_ESP_DEFAULT_CPU_FREQ_MHZ_240=y
```

## firmware/esp32_robot_idf/sdkconfig.defaults.board.s3_cam
```kconfig
# Freenove ESP32-S3-WROOM CAM (N8R8): 8 MB QIO flash + 8 MB Octal PSRAM,
# OV2640, onboard WS2812 on GPIO48. Overlays sdkconfig.defaults; build.sh
# composes both and runs `idf.py set-target esp32s3` first.
CONFIG_BR_BOARD_S3_CAM=y

# Flash: the partition table (partitions.csv) spans the first 4 MB (ota_0/1
# + the storage tail ending at 0x400000). An 8 MB chip runs it fine — the
# upper 4 MB is simply unused; keep the flash size at the table's span.
CONFIG_ESPTOOLPY_FLASHSIZE_4MB=y

# Octal PSRAM — required for the camera frame buffers. Reserve internal RAM
# for the time-critical radios (NimBLE, camera DMA) rather than letting
# WiFi/LWIP pools land in SPIRAM.
CONFIG_ESP32S3_SPIRAM_SUPPORT=y
CONFIG_SPIRAM=y
CONFIG_SPIRAM_MODE_OCT=y
CONFIG_SPIRAM_SPEED_80M=y
CONFIG_SPIRAM_USE_MALLOC=y
CONFIG_SPIRAM_TRY_ALLOCATE_WIFI_LWIP=y

# 240 MHz — the S3 headroom the camera JPEG path wants.
CONFIG_ESP_DEFAULT_CPU_FREQ_MHZ_240=y
```

## firmware/esp32_robot_idf/sdkconfig.defaults.esp32
```kconfig
# Classic ESP32 — AI-Thinker ESP32-CAM (the "MB" board the user has).
# 4 MB SPI PSRAM via the bundled chip; no hardware H.264 — camera path
# falls back to MJPEG-in-RTP for WebRTC video tracks.
CONFIG_ESPTOOLPY_FLASHSIZE_4MB=y
CONFIG_ESP32_SPIRAM_SUPPORT=y
CONFIG_SPIRAM_USE_MALLOC=y
CONFIG_SPIRAM_TRY_ALLOCATE_WIFI_LWIP=y

# Push allocations to PSRAM by default. mbedTLS contexts, libpeer SCTP/SRTP
# buffers, NimBLE non-critical state — none of these need internal-only RAM.
# Default threshold (16 KB) keeps everything <16 KB internal, which fragments
# the heap and starves the camera DMA's 32 KB contiguous request.
# - ALWAYSINTERNAL=256 — only allocations <256 B forced internal (small,
#   high-frequency stuff like task control blocks).
# - RESERVE_INTERNAL=32768 — keep 32 KB internal headroom unused by PSRAM-
#   capable callers, so the camera's MALLOC_CAP_INTERNAL+CAP_DMA call
#   always finds its block.
CONFIG_SPIRAM_MALLOC_ALWAYSINTERNAL=256
CONFIG_SPIRAM_MALLOC_RESERVE_INTERNAL=32768
```
